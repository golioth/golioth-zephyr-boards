## boards/arm/aludel_elixir/Kconfig.board
```kconfig
# Copyright (c) 2018-2020 Nordic Semiconductor ASA
# Copyright (c) 2023 Golioth, Inc.
# SPDX-License-Identifier: Apache-2.0

if SOC_NRF9160_SICA

config BOARD_ALUDEL_ELIXIR
	bool "Golioth Aludel Elixir"

config BOARD_ALUDEL_ELIXIR_NS
	bool "Golioth Aludel Elixir non-secure"

endif # SOC_NRF9160_SICA
```

## boards/arm/aludel_elixir_v1/Kconfig.board
```kconfig
# Copyright (c) 2018-2020 Nordic Semiconductor ASA
# Copyright (c) 2023 Golioth, Inc.
# SPDX-License-Identifier: Apache-2.0

if SOC_NRF9160_SICA

config BOARD_ALUDEL_ELIXIR_V1
	bool "Golioth Aludel Elixir v1"

config BOARD_ALUDEL_ELIXIR_V1_NS
	bool "Golioth Aludel Elixir v1 non-secure"

endif # SOC_NRF9160_SICA
```

## boards/arm/aludel_elixir_v1/aludel_elixir_v1_defconfig
```kconfig
# Copyright (c) 2023 Golioth, Inc.
# SPDX-License-Identifier: Apache-2.0

CONFIG_SOC_SERIES_NRF91X=y
CONFIG_SOC_NRF9160_SICA=y
CONFIG_BOARD_ALUDEL_ELIXIR_V1=y

# Enable MPU
CONFIG_ARM_MPU=y

# Enable hardware stack protection
CONFIG_HW_STACK_PROTECTION=y

# Enable TrustZone-M
CONFIG_ARM_TRUSTZONE_M=y

# Enable GPIO
CONFIG_GPIO=y

# Enable UART console
CONFIG_SERIAL=y
CONFIG_CONSOLE=y
CONFIG_UART_CONSOLE=y

# Enable pin controller drivers
CONFIG_PINCTRL=y

# Enable power regulator control
CONFIG_REGULATOR=y
```

## boards/golioth/aludel_elixir/Kconfig
```kconfig
# Copyright (c) 2025 Golioth, Inc.
# SPDX-License-Identifier: Apache-2.0

if BOARD_ALUDEL_ELIXIR

config ALUDEL_WIFI
	bool "Enable WiFi via the onboard esp32c3"
	default n
	imply WIFI
	imply WIFI_ESP_AT

config ALUDEL_WIFI_SHELL
	bool "Enable WiFi shell for the onboard esp32c3"
	default n
	imply NET_L2_WIFI_SHELL

endif # BOARD_ALUDEL_ELIXIR
```

## boards/golioth/aludel_elixir/board.yml
```yaml
board:
  name: aludel_elixir
  full_name: Golioth Aludel Elixir
  vendor: golioth
  revision:
    format: letter
    default: B
    exact: true
    revisions:
    - name: A
    - name: B
  socs:
    - name: nrf9160
      variants:
        - name: ns
```
